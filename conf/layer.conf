## conf/layer.conf
```bitbake
# We have a conf and classes directory, add to BBPATH
BBPATH .= ":${LAYERDIR}"

# We have recipes-* directories, add to BBFILES
BBFILES += "${LAYERDIR}/recipes-*/*/*.bb \
            ${LAYERDIR}/recipes-*/*/*.bbappend"

BBFILE_COLLECTIONS += "meta-rpi4-qt6-template"
BBFILE_PATTERN_meta-rpi4-qt6-template = "^${LAYERDIR}/"
BBFILE_PRIORITY_meta-rpi4-qt6-template = "6"

LAYERDEPENDS_meta-rpi4-qt6-template = "core raspberrypi qt6-layer"
LAYERSERIES_COMPAT_meta-rpi4-qt6-template = "scarthgap"
```
